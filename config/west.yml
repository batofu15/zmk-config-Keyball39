## config/west.yml
```yaml
manifest:
  remotes:
    - name: zmkfirmware
      url-base: https://github.com/zmkfirmware
    - name: sayu-hub
      url-base: https://github.com/sayu-hub
#    - name: petejohanson  # <--- ADDED this new remote
#      url-base: https://github.com/petejohanson
#    - name: kumamuk-git
#     url-base: https://github.com/kumamuk-git
  projects:
    - name: zmk
      remote: zmkfirmware #petejohanson
      revision: v0.2
      import: app/west.yml
    - name: zmk-pmw3610-driver
      remote: sayu-hub
      revision: main
  self:
    path: config
```
